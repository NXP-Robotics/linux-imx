// SPDX-License-Identifier: (GPL-2.0+ OR MIT)
/*
 * Copyright 2026 NXP
 */
 
#include "imx95-navqb-display-7inch.dts"

&gt911 {
	touchscreen-x-mm = <62>;
	touchscreen-y-mm = <110>;
};

&dsi_panel {
	compatible = "raspberrypi,dsi-5inch";
};